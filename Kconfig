## Kconfig
```kconfig
mainmenu "Backports from $(BACKPORTED_KERNEL_NAME) $(BACKPORTED_KERNEL_VERSION) (backports $(BACKPORTS_VERSION))"

config BACKPORT_DIR
	string
	default "$(BACKPORT_DIR)"
config BACKPORTS_VERSION
	string
	default "$(BACKPORTS_VERSION)"
config BACKPORTED_KERNEL_VERSION
	string
	default "$(BACKPORTED_KERNEL_VERSION)"
config BACKPORTED_KERNEL_NAME
	string
	default "$(BACKPORTED_KERNEL_NAME)"

# Packaging hacks
source "$(BACKPORT_DIR)/Kconfig.package.hacks"

# Code we backport
source "$(BACKPORT_DIR)/Kconfig.sources"

# these will be generated
source "$(BACKPORT_DIR)/Kconfig.kernel"
source "$(BACKPORT_DIR)/Kconfig.versions"
source "$(BACKPORT_DIR)/Kconfig.local"
```

## drivers/net/wireless/virtual/Kconfig
```kconfig
config VIRT_WIFI
	depends on n
	tristate "Wifi wrapper for ethernet drivers"
	depends on m
	depends on CFG80211
	help
	  This option adds support for ethernet connections to appear as if they
	  are wifi connections through a special rtnetlink device.
```
